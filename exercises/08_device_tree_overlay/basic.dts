/dts-v1/;

/ {
    compatible = "brcm,bcm2835";
    model = "Raspberry Pi Zero W";
    #address-cells = <2>;
    #size-cells = <1>;

    soc {
        #address-cells = <2>;
        #size-cells = <1>;
        ranges;

        uart0: uart@7e201000 {
            compatible = "arm,pl011";
            reg = <0x0 0x7e201000 0x1000>;
            status = "disabled";
        };
    };
};